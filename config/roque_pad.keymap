/ {
    keymap {
        compatible = "zmk,keymap";

        // No physical keys: the shield uses zmk,kscan-mock.
        // This empty/none binding is only to keep a conventional ZMK keymap.
        default_layer {
            display-name = "Trackpad";
            bindings = <&none>;
        };
    };
};
