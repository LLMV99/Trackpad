/* Input device split/listener definition. */
/ {
    split_inputs {
        #address-cells = <1>;
        #size-cells = <0>;

        input_split_unibody0: input_split_unibody0@0 {
            compatible = "zmk,input-split";
            reg = <0>;
            status = "disabled";
        };
    };

    input_listener_unibody0: input_listener_unibody0 {
        compatible = "zmk,input-listener";
        status = "disabled";
        device = <&input_split_unibody0>;
    };
};
